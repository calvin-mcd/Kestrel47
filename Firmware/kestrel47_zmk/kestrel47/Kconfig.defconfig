## Firmware/kestrel47_zmk/kestrel47/Kconfig.defconfig
```kconfig
# Copyright (c) 2020 The ZMK Contributors
# SPDX-License-Identifier: MIT

if SHIELD_KESTREL47

config ZMK_KEYBOARD_NAME
    default "Kestrel47"

endif
```

## Firmware/kestrel47_zmk/kestrel47/Kconfig.shield
```kconfig
# Copyright (c) 2020 The ZMK Contributors
# SPDX-License-Identifier: MIT

config SHIELD_KESTREL47
    def_bool $(shields_list_contains,kestrel47)
```

## Firmware/kestrel47_zmk/kestrel47/boards/nice_nano.conf
```kconfig
# Copyright (c) 2020 The ZMK Contributors
# SPDX-License-Identifier: MIT

# Enable underglow
CONFIG_ZMK_RGB_UNDERGLOW=y
# Use the STRIP config specific to the LEDs you're using
CONFIG_WS2812_STRIP=y
CONFIG_BT_CTLR_TX_PWR_PLUS_8=y
```
